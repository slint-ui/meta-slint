## conf/layer.conf
```bitbake
# We have a conf and classes directory, add to BBPATH
BBPATH .= ":${LAYERDIR}"

# We have recipes-* directories, add to BBFILES
BBFILES += "${LAYERDIR}/recipes-*/*/*.bb \
            ${LAYERDIR}/recipes-*/*/*.bbappend"

BBFILE_COLLECTIONS += "meta-slint"
BBFILE_PATTERN_meta-slint = "^${LAYERDIR}/"
BBFILE_PRIORITY_meta-slint = "6"

LAYERDEPENDS_meta-slint = "core rust-bin-layer"
LAYERSERIES_COMPAT_meta-slint = "kirkstone langdale mickledore nanbield scarthgap styhead walnascar whinlatter wrynose"

# The Rust recipes build via meta-rust-bin's cargo_bin class, which needs the
# panic strategy set for the target Rust std it ships.
RUST_PANIC_STRATEGY = "abort"

BBFILES_DYNAMIC += " \
    st-openstlinux:${LAYERDIR}/dynamic-layers/meta-st-openstlinux/*/*/*.bb \
    st-openstlinux:${LAYERDIR}/dynamic-layers/meta-st-openstlinux/*/*/*.bbappend \
    fus:${LAYERDIR}/dynamic-layers/meta-fus/*/*/*.bb \
    fus:${LAYERDIR}/dynamic-layers/meta-fus/*/*/*.bbappend \
    meta-rz-distro:${LAYERDIR}/dynamic-layers/meta-rz-distro/*/*/*.bb \
    meta-rz-distro:${LAYERDIR}/dynamic-layers/meta-rz-distro/*/*/*.bbappend \
    freescale-distro:${LAYERDIR}/dynamic-layers/meta-freescale-distro/*/*/*.bb \
    freescale-distro:${LAYERDIR}/dynamic-layers/meta-freescale-distro/*/*/*.bbappend \
    raspberrypi:${LAYERDIR}/dynamic-layers/meta-raspberrypi/*/*/*.bb \
    raspberrypi:${LAYERDIR}/dynamic-layers/meta-raspberrypi/*/*/*.bbappend \
    meta-ti-bsp:${LAYERDIR}/dynamic-layers/meta-ti/*/*/*.bb \
    meta-ti-bsp:${LAYERDIR}/dynamic-layers/meta-ti/*/*/*.bbappend \
    "

LICENSE_PATH += "${LAYERDIR}/custom-licenses"
```
